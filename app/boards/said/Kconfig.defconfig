## app/boards/said/Kconfig.defconfig
```kconfig
# SAID board configuration

# Copyright (c) 2017 Linaro Limited
# SPDX-License-Identifier: Apache-2.0

if BOARD_SAID

configdefault NET_L2_ETHERNET
	default y

endif # BOARD_SAID
```

## app/boards/said/Kconfig.said
```kconfig
# Copyright (c) 2017 Linaro Limited
# SPDX-License-Identifier: Apache-2.0

config BOARD_SAID
	select SOC_STM32F429XX
```

## app/boards/said/board.yml
```yaml
board:
  name: said 
  full_name: My Board from Scratch 
  vendor: st
  socs:
    - name: stm32f429xx
```

## app/drivers/our_driver/Kconfig
```kconfig
config OUR_DRIVER
	bool "Our Driver (LED sensor)"
	default y
	depends on DT_HAS_OUR_DRIVER_ENABLED
	select GPIO
	select SENSOR
	help
	  Enable the custom LED-backed sensor driver. sensor_sample_fetch()
	  turns the LED on; sensor_channel_get() turns it off and reports
	  its prior state.
```
