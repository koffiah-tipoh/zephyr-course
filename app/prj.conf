## CMakeLists.txt
```
cmake_minimum_required(VERSION 3.20.0)

list(APPEND BOARD_ROOT ${CMAKE_CURRENT_SOURCE_DIR})
find_package(Zephyr REQUIRED)
project(my_zephyr_app)

target_sources(app PRIVATE src/main.cpp)

add_subdirectory(drivers/our_driver)
```

## Kconfig
```
config APP_HEARTBEAT_PERIOD_MS
	int "Heartbeat LED period (ms)"
	default 500
	range 100 2000
	help
	  Sleep duration between heartbeat LED toggles, in milliseconds.

menuconfig LED_SUBSYSTEM
	bool "LED Subsystem"
	default y
	help
	  Enable the LED subsystem and its configuration options.

if LED_SUBSYSTEM

choice LED_BLINK_SLEEP_TIME
	prompt "LED blink sleep time"
	default BLINK_SLEEP_1000MS

config BLINK_SLEEP_250MS
	bool "Fast"

config BLINK_SLEEP_1000MS
	bool "Normal"

config BLINK_SLEEP_2000MS
	bool "Slow"

endchoice

config BLINK_SLEEP_TIME_MS
	int
	default 250  if BLINK_SLEEP_250MS
	default 1000 if BLINK_SLEEP_1000MS
	default 2000 if BLINK_SLEEP_2000MS
	default 0

menuconfig LED_ADVANCED_SETTINGS
	bool "Advanced LED settings"
	default n

if LED_ADVANCED_SETTINGS

config LED_BRIGHTNESS
	int "LED brightness (0-100)"
	range 0 100
	default 100

config LED_FADE_DURATION_MS
	int "LED fade duration (ms)"
	default 500

menu "Expert settings"

config LED_DEBUG
	bool "Enable LED debugging"
	default n

config LED_CUSTOM_BLINK_PATTERN
	bool "Custom blink pattern"
	default n

endmenu # Expert settings

endif # LED_ADVANCED_SETTINGS

endif # LED_SUBSYSTEM

source "Kconfig.zephyr"
rsource "drivers/our_driver/Kconfig"
```

## prj.conf
```kconfig
CONFIG_GPIO=y
CONFIG_LOG=y
CONFIG_SENSOR=y
CONFIG_OUR_DRIVER=y
CONFIG_SHELL=y
CONFIG_SHELL_TAB=y
CONFIG_SHELL_HISTORY=y
```

## app.overlay
```dts
#include <zephyr/dt-bindings/gpio/gpio.h>

/ {
	our_driver0: our_driver {
		compatible = "our,driver";
		/* Red LED (led2 / PB14) from the said board's said.dts */
		gpios = <&gpiob 14 GPIO_ACTIVE_HIGH>;
		status = "okay";
	};
};
```

## dts/bindings/our_driver.yaml
```yaml
description: Simple on-board LED exposed through the Zephyr sensor API
compatible: "our,driver"
include: base.yaml

properties:
  gpios:
    type: phandle-array
    required: true
    description: GPIO connected to the LED controlled by this driver
```

## src/main.cpp
```c
#include <zephyr/drivers/gpio.h>
#include <zephyr/kernel.h>
#include <zephyr/logging/log.h>
#include <zephyr/drivers/sensor.h>
#include "our_driver.h"

#define SLEEP_TIME_MS 1000

/* The devicetree node identifier for the "led0" alias. */
#define LED_NODE DT_ALIAS(led0)

static const struct gpio_dt_spec led = GPIO_DT_SPEC_GET(LED_NODE, gpios);

LOG_MODULE_REGISTER(main, LOG_LEVEL_INF);

void test_our_driver(void)
{
        const struct device *our_dev = DEVICE_DT_GET(DT_NODELABEL(our_driver0));

        if (!device_is_ready(our_dev)) {
                LOG_ERR("our_driver not ready");
                return;
        }

        sensor_sample_fetch(our_dev);     /* LED ON */
        k_msleep(1000);

        struct sensor_value val;
        sensor_channel_get(our_dev, SENSOR_CHAN_ALL, &val);  /* LED OFF */
        LOG_INF("LED was: %d", val.val1);

	/* Task 2: custom extension API, independent of the sensor API */
	our_driver_preset(our_dev, 3);
}


int main(void)
{
    bool led_state = true;

    if (!gpio_is_ready_dt(&led)) return 0;

    if (gpio_pin_configure_dt(&led, GPIO_OUTPUT_ACTIVE) < 0) return 0;

    /* Run the Task 1 driver test once before the blink loop starts */
    test_our_driver();

    while (1) {
        if (gpio_pin_toggle_dt(&led) < 0) return 0;

        led_state = !led_state;
        LOG_INF("LED state: %s", led_state ? "ON" : "OFF");
        k_msleep(SLEEP_TIME_MS);
    }
    return 0;
}
```
